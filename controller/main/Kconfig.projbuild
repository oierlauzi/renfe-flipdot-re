## controller/main/Kconfig.projbuild
```kconfig
menu "Flip-dot controller"

    config FLIPDOT_UART_NUM
        int "UART port for the display"
        range 1 2
        default 2
        help
            UART0 is the USB console. 1 and 2 are free.

    config FLIPDOT_TX_GPIO
        int "TX GPIO (to the MAX3490 DI)"
        default 17
        help
            Avoid the strapping pins GPIO0, 2, 12 and 15. GPIO16/17 are the
            UART2 defaults and are free on a WROOM devkit, but they are wired
            to PSRAM on WROVER modules -- use 32/33 there.

    config FLIPDOT_RX_GPIO
        int "RX GPIO (from the MAX3490 RO)"
        default 16

    config FLIPDOT_ADDRESS
        int "Display address (0-31)"
        range 0 31
        default 1
        help
            This unit was found at address 1. Overridable from the web UI.

    config FLIPDOT_BAUD
        int "Baud rate"
        default 1200

    config FLIPDOT_RESET_GPIO
        int "GPIO for the configuration-reset button, or -1 for none"
        range -1 39
        default 23
        help
            A push-button between this pin and ground. The pin is configured as
            an input with its internal pull-up, so no external parts are needed.

            GPIO23 is free on both WROOM and WROVER modules and is not a
            strapping pin. Avoid GPIO0, 2, 12 and 15 (strapping), 6-11 (flash),
            16/17 (the display UART by default), and 34-39, which are input-only
            and have no internal pull-up at all -- a floating pin there reads as
            a button held down.

    config FLIPDOT_RESET_HOLD_MS
        int "How long the reset button must be held, milliseconds"
        range 1000 30000
        default 5000
        help
            Long enough that it cannot be hit by accident. Erasing the
            configuration is the only way back in after a wrong passphrase, so
            it should be deliberate but not awkward.

    config FLIPDOT_SETTLE_MS
        int "Settle time after a repaint, milliseconds"
        default 3000
        help
            The dots are mechanical. This also bounds the global repaint rate,
            so no mode can flip the panel faster than this.

endmenu
```
